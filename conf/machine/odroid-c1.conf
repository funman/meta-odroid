## conf/machine/odroid-c1.conf
```bitbake
#-----------------------------------------------------------------------------
#@TYPE: Machine
#@NAME: ODROID-C1 (Amlogic S805)
#@DESCRIPTION: Machine configuration for the ODROID-C1 by hardkernel
#-----------------------------------------------------------------------------

TARGET_ARCH = "arm"

PREFERRED_PROVIDER_virtual/kernel ?= "linux-hardkernel"
PREFERRED_PROVIDER_virtual/bootloader ?= "u-boot-hardkernel"

KERNEL_IMAGETYPE = "uImage"
KERNEL_DEVICETREE = "meson8b_odroidc.dtb"
UBOOT_MACHINE = "odroidc_config"

IMAGE_FSTYPES += "tar.gz"
IMAGE_FSTYPES += "odroid-c1-sdimg"

require conf/machine/include/tune-cortexa5.inc

IMAGE_BOOT_FILES = "u-boot.${UBOOT_SUFFIX} bl1.bin.hardkernel"
IMAGE_PKG_TYPE = "deb"
IMAGE_CLASSES += "sdcard_image-odroid-c1"
```

## conf/machine/odroid-xu3.conf
```bitbake
#-----------------------------------------------------------------------------
#@TYPE: Machine
#@NAME: ODROID-C1 (Amlogic S805)
#@DESCRIPTION: Machine configuration for the ODROID-C1 by hardkernel
#-----------------------------------------------------------------------------

TARGET_ARCH = "arm"

PREFERRED_PROVIDER_virtual/kernel ?= "linux-hardkernel"
PREFERRED_PROVIDER_virtual/bootloader ?= "u-boot-hardkernel"

KERNEL_IMAGETYPE = "zImage"
KERNEL_DEVICETREE = "exynos5422-odroidxu3.dtb"

UBOOT_MACHINE = "odroid_config"

IMAGE_FSTYPES += "tar.gz"
IMAGE_FSTYPES += "odroid-xu3-sdimg"

require conf/machine/include/tune-cortexa15.inc

IMAGE_BOOT_FILES = "u-boot.${UBOOT_SUFFIX} bl1.bin.hardkernel"
IMAGE_PKG_TYPE = "deb"
IMAGE_CLASSES += "sdcard_image-odroid-xu3"
```
